## drivers/rpmsg/Kconfig
```kconfig
menu "Rpmsg drivers"

# RPMSG always gets selected by whoever wants it
config RPMSG
	tristate
	select VIRTIO
	select VIRTUALIZATION
	select GENERIC_ALLOCATOR

# RPMSG always gets selected by whoever wants it
config RPMSG_CLIENT
	tristate "Dummy rpmsg client driver for testing rpmsg -- loadable module" 
	depends on RPMSG && m
endmenu
```
